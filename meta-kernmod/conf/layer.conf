## meta-kernmod/conf/layer.conf
```bitbake
# We have a conf and classes directory, add to BBPATH
BBPATH .= ":${LAYERDIR}"

# We have recipes-* directories, add to BBFILES
BBFILES += "${LAYERDIR}/recipes-*/*/*.bb \
            ${LAYERDIR}/recipes-*/*/*.bbappend"

BBFILE_COLLECTIONS += "meta-kernmod"
BBFILE_PATTERN_meta-kernmod = "^${LAYERDIR}/"
BBFILE_PRIORITY_meta-kernmod = "6"

LAYERDEPENDS_meta-kernmod = "core"
LAYERSERIES_COMPAT_meta-kernmod = "kirkstone"
```
